## examples/benchmarks/project/Kconfig.proj
```kconfig
config CUSTOM_MEM_MAP
    bool 
	select custom_mem_map
	default y    

config TF_MAIN_STACK_SIZE    
    int "TFLM main stack size"
	default 131072
    
choice 
    prompt "select benchmark app"
    default BENCHMARK_KW
    config BENCHMARK_KW
        bool "Keyword detection"
    config BENCHMARK_KW_INT8
        bool "Keyword detection 8bit"
    config BENCHMARK_PD
        bool "Person detection"
endchoice    
```

## examples/kws/project/Kconfig.proj
```kconfig
#APP specific configuration.
config BF0_HCPU
    bool
    default y

config CUSTOM_MEM_MAP
    bool 
	select custom_mem_map
	default y    

config TF_MAIN_STACK_SIZE    
    int "TFLM main stack size"
	default 131072
```

## examples/memory_footprint/project/Kconfig.proj
```kconfig
config CUSTOM_MEM_MAP
    bool 
	select custom_mem_map
	default y    

config TF_MAIN_STACK_SIZE    
    int "TFLM main stack size"
	default 131072
choice 
    prompt "select project"
    default MEM_FP_BASE
    config MEM_FP_BASE
        bool "base line"
    config MEM_FP_INTP
        bool "Intepreter"
endchoice    	
```
